## build/conf/bblayers.conf
```bitbake
# my-extra-conf
BSPDIR := "${@os.path.abspath(os.path.dirname(d.getVar('FILE', True)) + '/../..')}"

# standard
POKY_BBLAYERS_CONF_VERSION = "2"
BBPATH = "${TOPDIR}"
BBFILES ?= ""

BBLAYERS ?= " \
    ${BSPDIR}/Documents/yocto-distrib/layers/meta-diy \
    ${BSPDIR}/Documents/yocto-distrib/layers/meta-openembedded/meta-networking \
    ${BSPDIR}/Documents/yocto-distrib/layers/meta-openembedded/meta-oe \
    ${BSPDIR}/Documents/yocto-distrib/layers/meta-openembedded/meta-perl \
    ${BSPDIR}/Documents/yocto-distrib/layers/meta-openembedded/meta-python \
    ${BSPDIR}/Documents/yocto-distrib/layers/meta-raspberrypi \
    ${BSPDIR}/Documents/yocto-distrib/layers/poky/meta \
    ${BSPDIR}/Documents/yocto-distrib/layers/poky/meta-poky \
    ${BSPDIR}/Documents/yocto-distrib/layers/poky/meta-yocto-bsp"
BBPATH ?= "${TOPDIR}"
BBFILES ??= ""
```

## build/conf/local.conf
```bitbake
# debug-tweaks
EXTRA_IMAGE_FEATURES = "debug-tweaks"

# diskmon
BB_DISKMON_DIRS = "\
    STOPTASKS,${TMPDIR},1G,100K \
    STOPTASKS,${DL_DIR},1G,100K \
    STOPTASKS,${SSTATE_DIR},1G,100K \
    STOPTASKS,/tmp,100M,100K \
    HALT,${TMPDIR},100M,1K \
    HALT,${DL_DIR},100M,1K \
    HALT,${SSTATE_DIR},100M,1K \
    HALT,/tmp,10M,1K"

# linux-firmware-rpidistro
LICENSE_FLAGS_ACCEPTED = "synaptics-killswitch"
# reduce_diskspace
INHERIT += "rm_work_and_downloads"

# standard
CONF_VERSION = "2"
PACKAGE_CLASSES = "package_deb"
SDKMACHINE = "x86_64"
USER_CLASSES = "buildstats"
PATCHRESOLVE = "noop"

MACHINE ??= "raspberrypi3"
DISTRO ??= "poky"
BBMULTICONFIG ?= ""
```
